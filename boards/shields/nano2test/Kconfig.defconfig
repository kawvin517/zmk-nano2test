## boards/shields/nano2test/Kconfig.defconfig
```kconfig
# Copyright (c) 2023 The ZMK Contributors
# SPDX-License-Identifier: MIT

config ZMK_KEYBOARD_NAME
    default "nano2test"

config ZMK_RGB_UNDERGLOW
    select WS2812_STRIP
    select SPI

if ZMK_DISPLAY

config SSD1306
    default y

config I2C
    default y

#choice ZMK_DISPLAY_WORK_QUEUE
#    default ZMK_DISPLAY_WORK_QUEUE_DEDICATED
#endchoice


if LVGL

config LV_Z_VDB_SIZE
    default 64

config LV_DPI_DEF
    default 148

config LV_Z_BITS_PER_PIXEL
    default 1

choice LV_COLOR_DEPTH
    default LV_COLOR_DEPTH_1
endchoice

endif # LVGL

endif # ZMK_DISPLAY
```

## boards/shields/nano2test/Kconfig.shield
```kconfig
# Copyright (c) 2023 The ZMK Contributors
# SPDX-License-Identifier: MIT

config SHIELD_NANO2TEST
    def_bool $(shields_list_contains,nano2test)
```

## boards/shields/nano2x2_test/Kconfig.shield
```kconfig
# Copyright (c) 2023 The ZMK Contributors
# SPDX-License-Identifier: MIT

config SHIELD_NANO2X2_TEST_LEFT
    def_bool $(shields_list_contains,nano2x2_test_left)
config SHIELD_NANO2X2_TEST_RIGHT
    def_bool $(shields_list_contains,nano2x2_test_right)
```

## boards/shields/nano2x3_test/Kconfig.shield
```kconfig
# Copyright (c) 2023 The ZMK Contributors
# SPDX-License-Identifier: MIT

config SHIELD_NANO2X3_TEST_LEFT
    def_bool $(shields_list_contains,nano2x3_test_left)
config SHIELD_NANO2X3_TEST_RIGHT
    def_bool $(shields_list_contains,nano2x3_test_right)
config SHIELD_NANO2X3_TEST_PAD
    def_bool $(shields_list_contains,nano2x3_test_pad)
```

## boards/shields/nano_v2_x2_test/Kconfig.defconfig
```kconfig
# Copyright (c) 2023 The ZMK Contributors
# SPDX-License-Identifier: MIT

if SHIELD_NANO_V2_X2_TEST_LEFT

config ZMK_SPLIT_ROLE_CENTRAL
    default y


config ZMK_KEYBOARD_NAME
    default "nano_v2_x2_test"
endif

if SHIELD_NANO_V2_X2_TEST_LEFT || SHIELD_NANO_V2_X2_TEST_RIGHT

config ZMK_SPLIT
    default y
    
config ZMK_RGB_UNDERGLOW
    select WS2812_STRIP
    select SPI

if ZMK_DISPLAY

config SSD1306
    default y

config I2C
    default y

if LVGL

config LV_Z_VDB_SIZE
    default 64

config LV_DPI_DEF
    default 148

config LV_Z_BITS_PER_PIXEL
    default 1

choice LV_COLOR_DEPTH
    default LV_COLOR_DEPTH_1
endchoice

endif # LVGL

endif # ZMK_DISPLAY
endif
```

## boards/shields/nano_v2_x2_test/Kconfig.shield
```kconfig
# Copyright (c) 2023 The ZMK Contributors
# SPDX-License-Identifier: MIT

config SHIELD_NANO_V2_X2_TEST_LEFT
    def_bool $(shields_list_contains,nano_v2_x2_test_left)
config SHIELD_NANO_V2_X2_TEST_RIGHT
    def_bool $(shields_list_contains,nano_v2_x2_test_right)
```
